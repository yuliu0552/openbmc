## meta-gdb/conf/layer.conf
```bitbake
# We have a conf and classes directory, add to BBPATH
BBPATH .= ":${LAYERDIR}"

BBFILES += "${LAYERDIR}/gdb/*.bb"


BBFILE_COLLECTIONS += "gdb"
BBFILE_PATTERN_gdb = "^${LAYERDIR}/"
BBFILE_PRIORITY_core = "5"
```
